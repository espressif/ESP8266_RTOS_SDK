## components/app_update/Kconfig
```kconfig
menu "App update"

config APP_UPDATE_CHECK_APP_SUM
    bool "Check APP binary data sum after downloading"
    default y
    help
        If enable this option, app update will check the sum of app binary data after downloading it.

config APP_UPDATE_CHECK_APP_HASH
    bool "Check APP binary data hash after downloading"
    default n
    help
        If enable this option, app update will check the hash of app binary data after downloading it.

    config APP_COMPILE_TIME_DATE
        bool "Use time/date stamp for app"
        default y
        help
            If set, then the app will be built with the current time/date stamp. It is stored in the app description
            structure. If not set, time/date stamp will be excluded from app image. This can be useful for getting the
            same binary image files made from the same source, but at different times.

    config APP_EXCLUDE_PROJECT_VER_VAR
        bool "Exclude PROJECT_VER from firmware image"
        default n
        help
            The PROJECT_VER variable from the build system will not affect the firmware image.
            This value will not be contained in the esp_app_desc structure.

    config APP_EXCLUDE_PROJECT_NAME_VAR
        bool "Exclude PROJECT_NAME from firmware image"
        default n
        help
            The PROJECT_NAME variable from the build system will not affect the firmware image.
            This value will not be contained in the esp_app_desc structure.

    config APP_PROJECT_VER_FROM_CONFIG
        bool "Get the project version from Kconfig"
        default n
        help
            If this is enabled, then config item APP_PROJECT_VER will be used for the variable PROJECT_VER.
            Other ways to set PROJECT_VER will be ignored.

    config APP_PROJECT_VER
        string "Project version"
        default "1"
        depends on APP_PROJECT_VER_FROM_CONFIG
        help
            Project version

endmenu
```

## components/coap/Kconfig
```kconfig
menu "COAP"

config ENABLE_COAP
    bool "Enable coap"
    default n
    select LWIP_IPV6
    help
        Enable this option and coap is to be used, IPv6 is to be Enable.
endmenu
```

## components/console/Kconfig
```kconfig
menu "Console"

config USING_ESP_CONSOLE
    bool "Using Espressif Console"
    default n
    select USING_ESP_VFS
    help
        Enable this option, espressif console can be used.

endmenu
```

## components/esp-wolfssl/Kconfig
```kconfig
menu "esp-wolfssl(internal)"

config ESP_WOLFSSL_INTERNAL
    bool "Enable esp-wolfssl(internal)"
    default n
    help
        Enable esp-wolfssl(internal).
        
        If users want to use external wolfssl, please disable this option.

config WOLFSSL_DEBUG
   bool "Enable esp-wolfssl(internal) debugging"
   default n
   help
       Enable esp-wolfssl(internal) debugging functions at compile time.

endmenu
```
