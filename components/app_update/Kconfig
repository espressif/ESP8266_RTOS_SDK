## components/esp_common/Kconfig
```kconfig
menu "Common ESP-related"

    config ESP_ERR_TO_NAME_LOOKUP
        bool "Enable lookup of error code strings"
        default "y"
        help
            Functions esp_err_to_name() and esp_err_to_name_r() return string representations of error codes from a
            pre-generated lookup table. This option can be used to turn off the use of the look-up table in order to
            save memory but this comes at the price of sacrificing distinguishable (meaningful) output string
            representations.

    config ESP_SYSTEM_EVENT_QUEUE_SIZE
        int "System event queue size"
        default 32
        help
            Config system event queue size in different application.

    config ESP_SYSTEM_EVENT_TASK_STACK_SIZE
        int "Event loop task stack size"
        default 2048
        help
            Config system event task stack size in different application.

    config ESP_MAIN_TASK_STACK_SIZE
        int "Main task stack size"
        default 3584
        help
            Configure the "main task" stack size. This is the stack of the task
            which calls app_main(). If app_main() returns then this task is deleted
            and its stack memory is freed.

    config ESP_TIMER_TASK_STACK_SIZE
        int "High-resolution timer task stack size"
        default 3584
        range 2048 65536
        help
            Configure the stack size of esp_timer/ets_timer task. This task is used
            to dispatch callbacks of timers created using ets_timer and esp_timer
            APIs. If you are seing stack overflow errors in timer task, increase
            this value.

            Note that this is not the same as FreeRTOS timer task. To configure
            FreeRTOS timer task size, see "FreeRTOS timer task stack size" option
            in "FreeRTOS" menu.

    choice ESP_CONSOLE_UART
        prompt "UART for console output"
        default ESP_CONSOLE_UART_DEFAULT
        help
            Select whether to use UART for console output (through stdout and stderr).

            - Default is to use UART0 on pins GPIO1(TX) and GPIO3(RX).
            - If "Custom" is selected, UART0 or UART1 can be chosen,
              and any pins can be selected.
            - If "None" is selected, there will be no console output on any UART, except
              for initial output from ROM bootloader. This output can be further suppressed by
              bootstrapping GPIO13 pin to low logic level.

        config ESP_CONSOLE_UART_DEFAULT
            bool "Default: UART0, TX=GPIO1, RX=GPIO3"
        config ESP_CONSOLE_UART_CUSTOM
            bool "Custom"
        config ESP_CONSOLE_UART_NONE
            bool "None"
    endchoice

    choice ESP_CONSOLE_UART_NUM
        prompt "UART peripheral to use for console output (0-1)"
        depends on ESP_CONSOLE_UART_CUSTOM
        default ESP_CONSOLE_UART_CUSTOM_NUM_0
        help
            Due of a ROM bug, UART2 is not supported for console output
            via ets_printf.

        config ESP_CONSOLE_UART_CUSTOM_NUM_0
            bool "UART0"
        config ESP_CONSOLE_UART_CUSTOM_NUM_1
            bool "UART1"
    endchoice

    config ESP_CONSOLE_UART_NUM
        int
        default 0 if ESP_CONSOLE_UART_DEFAULT || ESP_CONSOLE_UART_NONE
        default 0 if ESP_CONSOLE_UART_CUSTOM_NUM_0
        default 1 if ESP_CONSOLE_UART_CUSTOM_NUM_1

    config ESP_CONSOLE_UART_BAUDRATE
        int "UART console baud rate"
        depends on !ESP_CONSOLE_UART_NONE
        default 74880
        range 1200 4000000

    config ESP_UART0_SWAP_IO
        bool "Swap UART0 I/O pins"
        default n
        help
            Enable this option, UART0's I/O pins are swaped: TXD <-> RTS, RTX <-> CTS.

    config ESP_TASK_WDT
        bool "Initialize Task Watchdog Timer on startup"
        default y
        help
            The Task Watchdog Timer can be used to make sure individual tasks are still
            running. Enabling this option will cause the Task Watchdog Timer to be
            initialized automatically at startup. The Task Watchdog timer can be
            initialized after startup as well (see Task Watchdog Timer API Reference)

    config ESP_TASK_WDT_PANIC
        bool "Invoke panic handler on Task Watchdog timeout"
        depends on ESP_TASK_WDT
        default y
        help
            If this option is enabled, the Task Watchdog Timer will be configured to
            trigger the panic handler when it times out. This can also be configured
            at run time (see Task Watchdog Timer API Reference)

    choice ESP_TASK_WDT_TIMEOUT_S
        prompt "Task Watchdog timeout period (seconds)"
        default ESP_TASK_WDT_TIMEOUT_15N
        help
            Timeout period configuration for the Task Watchdog Timer in seconds.
            This is also configurable at run time.

        config ESP_TASK_WDT_TIMEOUT_13N
            bool "6.5536s"
        config ESP_TASK_WDT_TIMEOUT_14N
            bool "13.1072s"
        config ESP_TASK_WDT_TIMEOUT_15N
            bool "26.2144s"
    endchoice

    config ESP_TASK_WDT_TIMEOUT_S
        int
        default 13 if ESP_TASK_WDT_TIMEOUT_13N
        default 14 if ESP_TASK_WDT_TIMEOUT_14N
        default 15 if ESP_TASK_WDT_TIMEOUT_15N

endmenu # Common ESP-related
```

## components/esp_event/Kconfig
```kconfig
menu "Event Loop Library"

    config ESP_EVENT_LOOP_PROFILING
        bool "Enable event loop profiling"
        default n
        help
            Enables collections of statistics in the event loop library such as the number of events posted
            to/recieved by an event loop, number of callbacks involved, number of events dropped to to a full event
            loop queue, run time of event handlers, and number of times/run time of each event handler.

    config ESP_EVENT_POST_FROM_ISR
        bool "Support posting events from ISRs"
        default y
        help
            Enable posting events from interrupt handlers.

endmenu
```

## components/esp_http_client/Kconfig
```kconfig
menu "ESP HTTP client"


    config ESP_HTTP_CLIENT_ENABLE_HTTPS
        bool "Enable https"
        default y
        help
            This option will enable https protocol by linking mbedtls library and initializing SSL transport

    config ESP_HTTP_CLIENT_ENABLE_BASIC_AUTH
        bool "Enable HTTP Basic Authentication"
        default n
        help
            This option will enable HTTP Basic Authentication. It is disabled by default as Basic
            auth uses unencrypted encoding, so it introduces a vulnerability when not using TLS

    config HTTP_BUF_SIZE
        int "Default HTTP Buffer Size (both send and receive)"
        default 512
        range 512 1460
        help
            Set HTTP Buffer Size. The larger buffer size will make send and receive more size packet once. 
endmenu
```

## components/esp_https_ota/Kconfig
```kconfig
menu "ESP HTTPS OTA"

config OTA_BUF_SIZE
    int "Default OTA Buffer Size"
    default 256
    range 256 1460
    help
        Set OTA Buffer Size. The larger buffer size will read more size packet once and can reduce upgrade cost time.
        This buffer size depends on CONFIG_HTTP_BUF_SIZE. If you want to enlarge ota buffer size, please also enlarge CONFIG_HTTP_BUF_SIZE.
        OTA_BUF_SIZE equals to 1460 can save 40% upgrade time in contrast to OTA_BUF_SIZE which equals to 256. 

config OTA_ALLOW_HTTP
    bool "Allow HTTP for OTA (WARNING: ONLY FOR TESTING PURPOSE, READ HELP)"
    default n
    help
        It is highly recommended to keep HTTPS (along with server certificate validation) enabled.
        Enabling this option comes with potential risk of:
        - Non-encrypted communication channel with server
        - Accepting firmware upgrade image from server with fake identity

endmenu
```

## components/freertos/Kconfig
```kconfig
menu "FreeRTOS"

config DISABLE_FREERTOS
    bool "Disable FreeRTOS"
    default n
    help
        Enable this option, FreeRTOS will not be compiled and linked, and the user
        can user other OS platform.

config FREERTOS_ENABLE_REENT
    bool "Enable \"reent\" function"
    default n
    select NEWLIB_ENABLE
    help
        Enable "reent" function and FreeRTOS should use "reent" function of newlib.

        The configuration will enable newlib.

config FREERTOS_HZ
    int "Tick rate (Hz)"
    range 1 1000
    default 100
    help
        Select the tick rate at which FreeRTOS does pre-emptive context switching.

        The value must be the divisor of 1000, otherwise it may cause time mistake.

config FREERTOS_MAX_HOOK
    int "FreeRTOS hook max number"
    range 1 16
    default 2
    help
        configurate the max number of FreeRTOS hook function.

config FREERTOS_IDLE_TASK_STACKSIZE
    int "Idle Task stack size"
    range 1024 32768
    default 1024
    help
        The idle task has its own stack, sized in bytes. The default size is enough for most uses. Size can be reduced
        to 1024 bytes if no (or simple) FreeRTOS idle hooks are used and pthread local storage or FreeRTOS local storage
        cleanup callbacks are not used.

        The stack size may need to be increased above the default if the app installs idle or thread local storage
        cleanup hooks that use a lot of stack memory.

config FREERTOS_ISR_STACKSIZE
    int "ISR stack size"
    range 512 8192
    default 512
    help
        The interrupt handlers have their own stack. The size of the stack can be defined here.

config FREERTOS_EXTENED_HOOKS
    bool "Use FreeRTOS extened hooks"
    default n
    help
        By using the "esp_register_freertos_xxx_hook system", extened hook function offers a number
        of registerable hooks/callback functions that are called when a timer tick happens,
        the idle thread runs etc.

        Otherwise User can also use FreeRTOS raw hook functions "vApplicationIdleHook" and
        "vApplicationTickHook".

config FREERTOS_GLOBAL_DATA_LINK_IRAM
    bool "Link FreeRTOS global data to IRAM"
    default y
    depends on !LWIP_HIGH_THROUGHPUT
    depends on !SOC_FULL_ICACHE
    help
        Link FreeRTOS global data(.bss .data COMMON) from DRAM to IRAM.

config FREERTOS_CODE_LINK_TO_IRAM
    bool "Link FreeRTOS code to IRAM"
    default n
    help
        Link FreeRTOS code from Flash to IRAM.

config FREERTOS_TIMER_STACKSIZE
    int "Timer stack size"
    default 2048
    help
        The size of the stack used by the timer in FreeRTOS.

config TASK_SWITCH_FASTER
    bool "Task switch faster"
    default y
    help
        Enable this option, linking task switch function and its father functions to IRAM
        to speed up task switch. It is specific for faster I/O application and so on.

        But it may cost more 1KB IRAM, so user global heap may decrease 1KB.

config USE_QUEUE_SETS
    bool "Using Queue Sets"
    default n
    help
        Enable this option, the FreeRTOS macro "configUSE_QUEUE_SETS" in file "FreeRTOSConfig.h" will be set to be 1.

config ENABLE_FREERTOS_SLEEP
    bool "Enable FreeRTOS SLEEP"
    default n
    help
        Enable this option, FreeRTOS sleep module at idle task will be enable.
        
        The module is not working now, so if users want to make it work, they should do this themselves. 

config FREERTOS_USE_TRACE_FACILITY
    bool "Enable FreeRTOS trace facility"
    default n
    help
        If enabled, configUSE_TRACE_FACILITY will be defined as 1 in FreeRTOS.
        This will allow the usage of trace facility functions such as
        uxTaskGetSystemState().

config FREERTOS_USE_STATS_FORMATTING_FUNCTIONS
    bool "Enable FreeRTOS stats formatting functions"
    depends on FREERTOS_USE_TRACE_FACILITY
    default n
    help
        If enabled, configUSE_STATS_FORMATTING_FUNCTIONS will be defined as 1 in
        FreeRTOS. This will allow the usage of stats formatting functions such
        as vTaskList().

config FREERTOS_GENERATE_RUN_TIME_STATS
    bool "Enable FreeRTOS to collect run time stats"
    default n
    select FREERTOS_USE_TRACE_FACILITY
    select FREERTOS_USE_STATS_FORMATTING_FUNCTIONS
    help
        If enabled, configGENERATE_RUN_TIME_STATS will be defined as 1 in
        FreeRTOS. This will allow FreeRTOS to collect information regarding the
        usage of processor time amongst FreeRTOS tasks. Run time stats are
        generated using either the ESP Timer or the CPU Clock as the clock
        source (Note that run time stats are only valid until the clock source
        overflows). The function vTaskGetRunTimeStats() will also be available
        if FREERTOS_USE_STATS_FORMATTING_FUNCTIONS and
        FREERTOS_USE_TRACE_FACILITY are enabled. vTaskGetRunTimeStats() will
        display the run time of each task as a % of the total run time of all
        CPUs (task run time / no of CPUs) / (total run time / 100 )

choice FREERTOS_RUN_TIME_STATS_CLK
    prompt "Choose the clock source for run time stats"
    depends on FREERTOS_GENERATE_RUN_TIME_STATS
    default FREERTOS_RUN_TIME_STATS_USING_ESP_TIMER
    help
        Choose the clock source for FreeRTOS run time stats. Options are CPU0's
        CPU Clock or the ESP Timer. Both clock sources are 32 bits. The CPU
        Clock can run at a higher frequency hence provide a finer resolution
        but will overflow much quicker. Note that run time stats are only valid
        until the clock source overflows.

config FREERTOS_RUN_TIME_STATS_USING_ESP_TIMER
    bool "Use ESP TIMER for run time stats"
    help
        ESP Timer will be used as the clock source for FreeRTOS run time stats.
        The ESP Timer runs at a frequency of 1MHz regardless of Dynamic
        Frequency Scaling. Therefore the ESP Timer will overflow in
        approximately 4290 seconds.

config FREERTOS_RUN_TIME_STATS_USING_CPU_CLK
    bool "Use CPU Clock for run time stats"
    help
        CPU Clock will be used as the clock source for the generation of run
        time stats. The CPU Clock has a frequency dependent on
        ESP32_DEFAULT_CPU_FREQ_MHZ and Dynamic Frequency Scaling (DFS).
        Therefore the CPU Clock frequency can fluctuate between 80 to 240MHz.
        Run time stats generated using the CPU Clock represents the number of
        CPU cycles each task is allocated and DOES NOT reflect the amount of
        time each task runs for (as CPU clock frequency can change). If the CPU
        clock consistently runs at the maximum frequency of 240MHz, it will
        overflow in approximately 17 seconds.

endchoice

endmenu
```

## components/heap/Kconfig
```kconfig
menu "Heap memory"

    config HEAP_DISABLE_IRAM
        bool "Disable IRAM as heap memory"
        default n
        help
            Disable IRAM as heap memory, and heap memory only use DRAM.

    config HEAP_TRACING
        bool "Enables heap tracing API"
        default n
        help
            Enables heap tracing API.

    config HEAP_PRIO_8BIT_RAM
        bool "Prioritize allocation of 8-bit access capable RAM"
        default n
        depends on !HEAP_DISABLE_IRAM
        help
            Set DRAM region ahead of IRAM region during initialization, so that allocations
            can be made against it first.

endmenu
```

## components/libsodium/Kconfig
```kconfig
menu "libsodium"

config LIBSODIUM_USE_MBEDTLS_SHA
    bool "Use mbedTLS SHA256 & SHA512 implementations"
    default y
    help
        If this option is enabled, libsodium will use thin wrappers
        around mbedTLS for SHA256 & SHA512 operations.

        This saves some code size if mbedTLS is also used. However it
        is incompatible with Espressif SHA (due to the
        way libsodium's API manages SHA state).

endmenu # libsodium
```
