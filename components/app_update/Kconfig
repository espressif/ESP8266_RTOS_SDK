## components/util/Kconfig
```kconfig
menu "Util"

config util_assert
    bool "Enable assert for util components"
    default n
    help
        Enable this option, util components will use assert to check if input
        parameters are correct.

        Disable this option will speed up the process of some calculation a lot.

config ESP_SHA
   bool "Enable Espressif SHA"
   default n
   help
       Enable Espressif SHA1, SHA256, SHA384 & SHA512 for other components to
       save code size for ESP8285(ESP8266 + 1MB flash) users.

       Although this option is disable, bootloader will use it if booloader
       is configured to use SHA256 to check hash.

       Disabling the "assert" function at menuconfig can speed up the calculation.

config ESP_AES
   bool "Enable Espressif AES"
   default y
   help
       Enable Espressif AES ECB, CBC, CFB128, CFB8 & CRT for other components to
       speed up process speed and save code size.

       ESP8285 is like ESP8266 + 1MB flash, but its internal I/O connection from CPU
       core to flash is DIO not QIO, which makes it read flash data slower.
       So the function will speed up ESP8285 obviously.

       The calculation uses "ibus_data" to speed up load data from instruction bus.

       Disabling the "assert" function at menuconfig can speed up the calculation.

config ESP_MD5
   bool "Enable Espressif MD5"
   default y
   help
       Enable Espressif MD5 for other components to
       speed up process speed and save code size.

       ESP8285 is like ESP8266 + 1MB flash, but its internal I/O connection from CPU
       core to flash is DIO not QIO, which makes it read flash data slower.
       So the function will speed up ESP8285 obviously.

       The calculation uses "ibus_data" to speed up load data from instruction bus.

       Disabling the "assert" function at menuconfig can speed up the calculation.

config ESP_ARC4
   bool "Enable Espressif ARC4"
   default y
   help
       Enable Espressif ARC4 for other components to
       speed up process speed and save code size.

       ESP8285 is like ESP8266 + 1MB flash, but its internal I/O connection from CPU
       core to flash is DIO not QIO, which makes it read flash data slower.
       So the function will speed up ESP8285 obviously.

       The calculation uses "ibus_data" to speed up load data from instruction bus.

       Disabling the "assert" function at menuconfig can speed up the calculation.

endmenu # Util
```

## components/vfs/Kconfig
```kconfig
menu "Virtual file system"

config USING_ESP_VFS
    bool "Using espressif VFS"
    default n
    help
        Enable this option, espressif  VFS can be used. Users can use APIs like "open", "read", "write"
        and so on to operate I/O device which is registered.

config SUPPRESS_SELECT_DEBUG_OUTPUT
    bool "Suppress select() related debug outputs"
    default y
    depends on USING_ESP_VFS
    help
        Select() related functions might produce an unconveniently lot of
        debug outputs when one sets the default log level to DEBUG or higher.
        It is possible to suppress these debug outputs by enabling this
        option.

config SUPPORT_TERMIOS
    bool "Add support for termios.h"
    default y
    depends on USING_ESP_VFS
    help
        Disabling this option can save memory when the support for termios.h is not required.

endmenu
```
