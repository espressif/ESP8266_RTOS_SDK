PROVIDE ( ets_memcpy = 0x400018b4 );

PROVIDE ( SPIRead = 0x40004b1c );
PROVIDE ( SPIWrite = 0x40004a4c );
PROVIDE ( SPIEraseSector = 0x40004a00 );

PROVIDE ( gpio_input_get = 0x40004cf0 );

PROVIDE ( xthal_get_ccount = 0x4000dd38 );
PROVIDE ( uart_div_modify = 0x400039d8 );
PROVIDE ( ets_io_vprintf = 0x40001f00 );