## components/wifi_provisioning/Kconfig
```kconfig
menu "Wi-Fi Provisioning Manager"

    config ENABLE_UNIFIED_PROVISIONING
        bool "Enable Unified Provisioning"
        default n
        select ENABLE_MDNS
        help
            This enables Unified Provisioning feature along with required components like Wifi-Provisioning, Protocomm and their mbedtls dependencies.

    config WIFI_PROV_SCAN_MAX_ENTRIES
        int "Max Wi-Fi Scan Result Entries"
        default 16
        range 1 255
        depends on ENABLE_UNIFIED_PROVISIONING
        help
            This sets the maximum number of entries of Wi-Fi scan results that will be kept by the provisioning manager

    config WIFI_PROV_AUTOSTOP_TIMEOUT
        int "Provisioning auto-stop timeout"
        default 30
        range 5 600
        depends on ENABLE_UNIFIED_PROVISIONING
        help
            Time (in seconds) after which the Wi-Fi provisioning manager will auto-stop after connecting to
            a Wi-Fi network successfully.

endmenu
```

## components/wpa_supplicant/Kconfig
```kconfig
menu "wpa_supplicant"

config LTM_FAST
    bool "Use faster div, esptmod, sqr, montgomery multiplication algorithm"
    default y
    help
        Enable the option can enable faster div, faster exptmod, faster sqr, fast
        montgomery multiplication algorithm. Enable this option will cost about 
        3K ROM more than disable this option.

endmenu
```

## examples/common_components/protocol_examples_common/Kconfig.projbuild
```kconfig
menu "Example Connection Configuration"
    config EXAMPLE_WIFI_SSID
        string "WiFi SSID"
        default "myssid"
        help
            SSID (network name) for the example to connect to.

    config EXAMPLE_WIFI_PASSWORD
        string "WiFi Password"
        default "mypassword"
        help
            WiFi password (WPA or WPA2) for the example to use.
            Can be left blank if the network has no security set.

    config EXAMPLE_CONNECT_IPV6
        bool "Obtain IPv6 address"
        default n
        select LWIP_IPV6
        help
            By default, examples will wait until IPv4 and IPv6 local link addresses are obtained.
            Disable this option if the network does not support IPv6.
            Choose the preferred IPv6 address type if the connection code should wait until other than
            the local link address gets assigned.

    if EXAMPLE_CONNECT_IPV6
        choice EXAMPLE_CONNECT_PREFERRED_IPV6
            prompt "Preferred IPv6 Type"
            default EXAMPLE_CONNECT_IPV6_PREF_LOCAL_LINK
            help
                Select which kind of IPv6 address the connect logic waits for.

            config EXAMPLE_CONNECT_IPV6_PREF_LOCAL_LINK
                bool "Local Link Address"
                help
                    Blocks until Local link address assigned.

            config EXAMPLE_CONNECT_IPV6_PREF_GLOBAL
                bool "Global Address"
                select LWIP_IPV6_AUTOCONFIG
                help
                    Blocks until Global address assigned.
        endchoice

    endif
endmenu
```

## examples/peripherals/spi/high_performance/spi_master/sdkconfig.defaults
```kconfig
CONFIG_ESP8266_HSPI_HIGH_THROUGHPUT=y

CONFIG_ESP8266_DEFAULT_CPU_FREQ_160=y
CONFIG_ESP8266_DEFAULT_CPU_FREQ_MHZ=160

CONFIG_FREERTOS_CODE_LINK_TO_IRAM=y
```

## examples/peripherals/spi/high_performance/spi_slave/sdkconfig.defaults
```kconfig
CONFIG_ESP8266_HSPI_HIGH_THROUGHPUT=y

CONFIG_ESP8266_DEFAULT_CPU_FREQ_160=y
CONFIG_ESP8266_DEFAULT_CPU_FREQ_MHZ=160
```

## examples/protocols/aws_iot/subscribe_publish/sdkconfig.defaults
```kconfig
# Enable AWS IoT SDK support
CONFIG_AWS_IOT_SDK=y
CONFIG_MBEDTLS_SSL_IN_CONTENT_LEN=8192
CONFIG_MBEDTLS_SSL_OUT_CONTENT_LEN=1024
CONFIG_MBEDTLS_SSL_ALPN=y

# Enable FATFS read only with long filename support
# for loading Cert/CA/etc from filesystem
# (if enabled in config)
CONFIG_FATFS_READONLY=y
CONFIG_FATFS_CODEPAGE_437=y
CONFIG_FATFS_LFN_HEAP=y
```

## examples/protocols/aws_iot/thing_shadow/sdkconfig.defaults
```kconfig
# Enable AWS IoT SDK support
CONFIG_AWS_IOT_SDK=y
CONFIG_NEWLIB_LIBRARY_LEVEL_NORMAL=y

# Enable FATFS read only with long filename support
# for loading Cert/CA/etc from filesystem
# (if enabled in config)
CONFIG_FATFS_CODEPAGE_437=y
CONFIG_FATFS_LFN_HEAP=y
```

## examples/protocols/coap_server/main/Kconfig.projbuild
```kconfig
menu "Example Configuration"
    config TARGET_MULTICAST_IPV4
        string "IPv4 multicast address"
        default "232.10.11.12"
        help
            Target IP for the example to listen.

    config TARGET_MULTICAST_IPV6
        string "IPv6 multicast address"
        default "ff02::fc"
        help
            Target IP for the example to listen.
endmenu
```

## examples/protocols/esp_http_client/sdkconfig.defaults
```kconfig
CONFIG_NEWLIB_LIBRARY_LEVEL_NORMAL=y
CONFIG_MBEDTLS_SSL_OUT_CONTENT_LEN=1024
CONFIG_MBEDTLS_SSL_IN_CONTENT_LEN=16384
```

## examples/protocols/mdns/main/Kconfig.projbuild
```kconfig
menu "Example Configuration"

config MDNS_HOSTNAME
    string "mDNS Hostname"
	default "esp32-mdns"
	help
		mDNS Hostname for example to use

config MDNS_INSTANCE
    string "mDNS Instance Name"
	default "ESP32 with mDNS"
	help
		mDNS Instance Name for example to use

endmenu
```

## examples/protocols/modbus/tcp/mb_tcp_slave/sdkconfig.defaults
```kconfig
#
# Modbus configuration
#
CONFIG_FMB_COMM_MODE_TCP_EN=y
CONFIG_FMB_TCP_PORT_DEFAULT=502
CONFIG_FMB_TCP_CONNECTION_TOUT_SEC=20
CONFIG_FMB_PORT_TASK_STACK_SIZE=4096
CONFIG_FMB_PORT_TASK_PRIO=10
CONFIG_FMB_MASTER_TIMEOUT_MS_RESPOND=1000
CONFIG_FMB_MASTER_DELAY_MS_CONVERT=300
CONFIG_MB_SLAVE_ADDR=1
CCONFIG_EXAMPLE_CONNECT_IPV6=n
```

## examples/protocols/openssl_client/main/Kconfig.projbuild
```kconfig
menu "Example Configuration"

config TARGET_DOMAIN
    string "Target Domain"
    default "192.168.4.1"
    help
        Target domain for the example to connect to.

config TARGET_PORT_NUMBER
    int "Target port number"
    range 0 65535
    default 443
    help
        Target port number for the example to connect to.

endmenu
```

## examples/protocols/openssl_demo/sdkconfig.defaults
```kconfig
#
# Override some defaults so wolfSSL is enabled
# by default in this example
#
CONFIG_MBEDTLS_SSL_MAX_CONTENT_LEN=8192
```

## examples/provisioning/softap_prov/sdkconfig.defaults
```kconfig
CONFIG_ENABLE_UNIFIED_PROVISIONING=y
CONFIG_LWIP_NETIF_LOOPBACK=y
CONFIG_LWIP_LOOPBACK_MAX_PBUFS=1
```

## examples/system/factory-test/Kconfig.projbuild
```kconfig
menu "Factory-test config"

config FACTORY_TEST
    bool "Enable factory test"
    default n
    select BOOTLOADER_INIT_SPI_FLASH
    help
        Enable this option, project compiling script will generate factory test firmware.

endmenu
```

## examples/system/factory-test/components/rf_test/Kconfig
```kconfig
menu "Nano Console"

config NC_ECHO_CMD
    bool "echo input command"
    default y
    help
        Enable this option, the console terminal will echo the input command.

endmenu
```

## examples/system/factory-test/sdkconfig.defaults
```kconfig
#
# Virtual file system
#
CONFIG_USING_ESP_VFS=y

#
# PThreads
#
CONFIG_ENABLE_PTHREAD=y

#
# Partition Table
#
CONFIG_PARTITION_TABLE_TWO_OTA=y

#
# Bootloader config
#
CONFIG_BOOTLOADER_APP_TEST=y
CONFIG_BOOTLOADER_APP_TEST_IN_OTA_1=y
CONFIG_BOOTLOADER_NUM_PIN_APP_TEST=12
```
