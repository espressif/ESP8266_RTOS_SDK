## examples/system/ota/native_ota/1MB_flash/new_to_new_no_old/sdkconfig.defaults
```kconfig
#
# Serial flasher config
#
CONFIG_ESPTOOLPY_FLASHSIZE_1MB=y

#
# Partition Table
#
CONFIG_PARTITION_TABLE_TWO_OTA=y
CONFIG_PARTITION_TABLE_CUSTOM_FILENAME="partitions.csv"
CONFIG_PARTITION_TABLE_FILENAME="partitions_two_ota.1MB.csv"

#
# Example Configuration
#
CONFIG_EXAMPLE_FILENAME="ota.ota.bin"
```

## examples/system/ota/native_ota/1MB_flash/new_to_new_no_old_copy/sdkconfig.defaults
```kconfig
#
# Serial flasher config
#
CONFIG_ESPTOOLPY_FLASHSIZE_1MB=y

#
# Partition Table
#
CONFIG_PARTITION_TABLE_TWO_OTA=y
CONFIG_PARTITION_TABLE_CUSTOM_FILENAME="partitions.csv"
CONFIG_PARTITION_TABLE_FILENAME="partitions_two_ota.1MB.csv"

#
# ESP8266-specific
#
CONFIG_ESP8266_BOOT_COPY_APP=y

#
# Example Configuration
#
CONFIG_EXAMPLE_FILENAME="ota.ota.bin"
```

## examples/system/ota/native_ota/1MB_flash/new_to_new_with_old/sdkconfig.defaults
```kconfig
#
# Serial flasher config
#
CONFIG_ESPTOOLPY_FLASHSIZE_1MB=y

#
# Partition Table
#
CONFIG_PARTITION_TABLE_CUSTOM=y
CONFIG_PARTITION_TABLE_CUSTOM_FILENAME="partitions_two_ota_v2tov3.1MB.csv"
CONFIG_PARTITION_TABLE_OFFSET=0x5000
CONFIG_PARTITION_TABLE_FILENAME="partitions_two_ota_v2tov3.1MB.csv"

#
# Example Configuration
#
CONFIG_EXAMPLE_FILENAME="ota.v2_to_v3.ota.bin"

#
# ESP8266-specific
#
CONFIG_ESP8266_OTA_FROM_OLD=y
```

## examples/system/ota/native_ota/2+MB_flash/new_to_new_no_old/main/Kconfig.projbuild
```kconfig
menu "Example Configuration"

config SERVER_IP
    string "HTTP Server IP"
	default "192.168.0.3"
	help
		HTTP Server IP to download the image file from.

		See example README.md for details.

config SERVER_PORT
	string "HTTP Server Port"
	default "8070"
	help
		HTTP Server port to connect to.
		Should be chosen not to conflict with any other port used
		on the system.

config EXAMPLE_FILENAME
	string "HTTP GET Filename"
	default "/hello_world.bin"
	help
		Filename of the app image file to download for
		the OTA update.

endmenu
```

## examples/system/ota/native_ota/2+MB_flash/new_to_new_no_old/sdkconfig.defaults
```kconfig
#
# Serial flasher config
#
CONFIG_ESPTOOLPY_FLASHSIZE_2MB=y

#
# Partition Table
#
CONFIG_PARTITION_TABLE_TWO_OTA=y
CONFIG_PARTITION_TABLE_CUSTOM_FILENAME="partitions.csv"
CONFIG_PARTITION_TABLE_FILENAME="partitions_two_ota.csv"

#
# Example Configuration
#
CONFIG_EXAMPLE_FILENAME="ota.ota.bin"
```

## examples/system/ota/native_ota/2+MB_flash/new_to_new_with_old/sdkconfig.defaults
```kconfig
#
# Serial flasher config
#
CONFIG_ESPTOOLPY_FLASHSIZE_2MB=y

#
# Partition Table
#
CONFIG_PARTITION_TABLE_CUSTOM=y
CONFIG_PARTITION_TABLE_CUSTOM_FILENAME="partitions_two_ota_v2tov3.2MB.csv"
CONFIG_PARTITION_TABLE_OFFSET=0x8000
CONFIG_PARTITION_TABLE_FILENAME="partitions_two_ota_v2tov3.2MB.csv"

#
# Example Configuration
#
CONFIG_EXAMPLE_FILENAME="ota.v2_to_v3.ota.bin"

#
# ESP8266-specific
#
CONFIG_ESP8266_OTA_FROM_OLD=y
```

## examples/system/ota/native_ota/sdkconfig.defaults
```kconfig
# Default sdkconfig parameters to use the ESP8266 OTA
CONFIG_LWIP_SOCKET_MULTITHREAD=

CONFIG_ESPTOOLPY_FLASHSIZE_1MB=y

CONFIG_PARTITION_TABLE_CUSTOM=y
CONFIG_PARTITION_TABLE_CUSTOM_FILENAME="partitions_two_ota.1MB.mini.csv"
CONFIG_PARTITION_TABLE_OFFSET=0x4000
```

## examples/system/ota/sdkconfig.defaults
```kconfig
# Default sdkconfig parameters to use the ESP8266 OTA
CONFIG_ESPTOOLPY_FLASHSIZE_2MB=y
CONFIG_PARTITION_TABLE_TWO_OTA=y
CONFIG_LWIP_SOCKET_MULTITHREAD=
```

## examples/system/ota/simple_ota_example/main/Kconfig.projbuild
```kconfig
menu "Example Configuration"

config FIRMWARE_UPGRADE_URL
    string "firmware upgrade url endpoint"
    default "https://192.168.0.3:8070/hello-world.bin"
    help
        URL of server which hosts the firmware
        image.
endmenu
```

## examples/system/ota/simple_ota_example/sdkconfig.defaults
```kconfig
# Default sdkconfig parameters to use the OTA
# partition table layout, with a 4MB flash size
CONFIG_ESPTOOLPY_FLASHSIZE_4MB=y
CONFIG_PARTITION_TABLE_TWO_OTA=y
CONFIG_NEWLIB_LIBRARY_LEVEL_NORMAL=y
CONFIG_MBEDTLS_SSL_OUT_CONTENT_LEN=1024
CONFIG_MBEDTLS_SSL_IN_CONTENT_LEN=16384
```

## examples/system/universal_ota/sdkconfig.defaults
```kconfig
# Default sdkconfig parameters to use the ESP8266 OTA
CONFIG_LWIP_SOCKET_MULTITHREAD=

CONFIG_ESPTOOLPY_FLASHSIZE_1MB=y

CONFIG_PARTITION_TABLE_CUSTOM=y
CONFIG_PARTITION_TABLE_CUSTOM_FILENAME="partitions_two_ota.1MB.mini.csv"
CONFIG_PARTITION_TABLE_OFFSET=0x4000
CONFIG_APP1_OFFSET=0x6000
CONFIG_APP1_SIZE=0x7A000
CONFIG_APP2_OFFSET=0x86000
CONFIG_APP2_SIZE=0x7A000
```

## examples/wifi/iperf/sdkconfig.defaults
```kconfig
CONFIG_ESP8266_WIFI_AMPDU_RX_ENABLED=y
CONFIG_ESP8266_WIFI_RX_BUFFER_NUM=26
CONFIG_ESP8266_WIFI_LEFT_CONTINUOUS_RX_BUFFER_NUM=4
CONFIG_ESP8266_DEFAULT_CPU_FREQ_160=y
CONFIG_SOC_FULL_ICACHE=y
CONFIG_LWIP_TCP_SND_BUF_DEFAULT=11680
CONFIG_LWIP_TCP_WND_DEFAULT=7300
CONFIG_LWIP_TCP_MSS=1460
CONFIG_LWIP_TCP_RECVMBOX_SIZE=7
CONFIG_NEWLIB_NANO_FORMAT=n
```

## examples/wifi/power_save/main/Kconfig.projbuild
```kconfig
menu "Example Configuration"

    config ESP_WIFI_SSID
        string "WiFi SSID"
        default "myssid"
        help
            SSID (network name) for the example to connect to.

    config ESP_WIFI_PASSWORD
        string "WiFi Password"
        default "mypassword"
        help
            WiFi password (WPA or WPA2) for the example to use.

    choice ESP_POWER_SAVE_MODE
        prompt "power save mode"
        default EXAMPLE_POWER_SAVE_MIN_MODEM
        help
            Power save mode for the esp8266 to use. Modem sleep mode includes minimum and maximum power save modes.
            In minimum/maximum power save mode, station wakes up every DTIM to receive beacon. Broadcast data will not be
            lost because it is transmitted after DTIM. However, it can not save much more power if DTIM is short
            for DTIM is determined by AP.

        config EXAMPLE_POWER_SAVE_NONE
            bool "none"
        config EXAMPLE_POWER_SAVE_MIN_MODEM
            bool "minimum modem"
        config EXAMPLE_POWER_SAVE_MAX_MODEM
            bool "maximum modem"
    endchoice
endmenu
```

## examples/wifi/smart_config/main/Kconfig.projbuild
```kconfig
menu "Example Configuration"

choice ESP_SMARTCONFIG_TYPE
	prompt "Smartconfig Type"
	default ESP_TOUCH
	help
		Set protocol type of SmartConfig.

		Start SmartConfig method according to the selected type when user select "ESPTouch", "AirKiss",  "ESPTouch and AirKiss" or "ESPTouch V2" type.

config ESP_TOUCH
	bool "ESPTouch"
config AIRKISS
	bool "AirKiss"
config ESP_TOUCH-AIRKISS
	bool "ESPTouch and AirKiss"
config ESP_TOUCH_V2
	bool "ESPTouch-V2"
endchoice

config ESP_SMARTCONFIG_TYPE
	int
	default 0 if ESP_TOUCH
	default 1 if AIRKISS
	default 2 if ESP_TOUCH-AIRKISS
	default 3 if ESP_TOUCH_V2

endmenu
```

## examples/wifi/sniffer/main/Kconfig.projbuild
```kconfig
menu "Example Configuration"

config CHANNEL
    int "Channel"
    range 1 13
    default 1

config FILTER_MASK_MGMT
    bool "Receive management packets"
    default y

config FILTER_MASK_CTRL
    bool "Receive ctrl packets"
    default n

config FILTER_MASK_DATA
    bool "Receive data packets"
    default n

config FILTER_MASK_DATA_FRAME_PAYLOAD
    depends on FILTER_MASK_DATA
    bool "Receive data frame payload"
    default n
    help
        Select this option to enable recv data frame payload

config FILTER_MASK_MISC
    bool "Receive misc packets"
    default n

endmenu
```

## tools/unit-test-app/sdkconfig.defaults
```kconfig
CONFIG_PARTITION_TABLE_CUSTOM=y
CONFIG_PARTITION_TABLE_CUSTOM_FILENAME="partition_table_unit_test_app.csv"
CONFIG_PARTITION_TABLE_FILENAME="partition_table_unit_test_app.csv"
CONFIG_PARTITION_TABLE_OFFSET=0x8000
CONFIG_TASK_WDT=
CONFIG_ENABLE_PTHREAD=y

CONFIG_USING_SPIFFS=y
```
